## Kconfig
```kconfig
#
# For a description of the syntax of this configuration file,
# see the file kconfig-language.txt in the NuttX tools repository.
#

config EXAMPLES_GHIFP
	tristate "Gacrux Host I/F protocol test"
	default y
	---help---
		Enable the Gacrux Host I/F protocol test

if EXAMPLES_GHIFP

config EXAMPLES_GHIFP_PROGNAME
	string "Program name"
	default "ghifp"
	---help---
		This is the name of the program that will be use when the NSH ELF
		program is installed.

config EXAMPLES_GHIFP_PRIORITY
	int "Gacrux Host I/F protocol test task priority"
	default 100

config EXAMPLES_GHIFP_STACKSIZE
	int "Gacrux Host I/F protocol test stack size"
	default 2048

endif
```

## ghifp-defconfig
```kconfig
CONFIG_CXD56_SPI=y
CONFIG_CXD56_SPI5=y
CONFIG_CXD56_I2C=y
CONFIG_CXD56_I2C0=y
# CONFIG_CXD56_I2C0_SCUSEQ is not set
CONFIG_SYSTEM_GPIO=y
CONFIG_NSH_LINELEN=128
CONFIG_SYSTEM_ZMODEM=y
CONFIG_SYSTEM_ZMODEM_RCVBUFSIZE=1024
CONFIG_SYSTEM_ZMODEM_PKTBUFSIZE=1024
CONFIG_SYSTEM_ZMODEM_MOUNTPOINT="/mnt/spif"
# CONFIG_EXAMPLES_GACRUX_GPIO is not set
CONFIG_EXAMPLES_GHIFP_STACKSIZE=4096
```
